// SPDX-License-Identifier: GPL-2.0-only

#include "litex.dtsi"

/ {
	model = "LiteX VexRiscV";
	compatible = "litex,vexriscv";

	memory@40000000 {
		device_type = "memory";
		reg = <0x40000000 0x00800000>;
	};
};

&uart0 {
	status = "okay";
};
